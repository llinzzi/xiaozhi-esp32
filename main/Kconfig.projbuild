## main/Kconfig.projbuild
```kconfig
menu "Xiaozhi Assistant"

config OTA_URL
    string "Default OTA URL"
    default "https://api.tenclass.net/xiaozhi/ota/"
    help
        The application will access this URL to check for new firmwares and server address.


choice
    prompt "Default Language"
    default LANGUAGE_ZH_CN
    help
        Select device display language

    config LANGUAGE_ZH_CN
        bool "Chinese"
    config LANGUAGE_ZH_TW
        bool "Chinese Traditional"
    config LANGUAGE_EN_US
        bool "English"
    config LANGUAGE_JA_JP
        bool "Japanese"
endchoice

choice BOARD_TYPE
    prompt "Board Type"
    default BOARD_TYPE_BREAD_COMPACT_WIFI
    help
        Board type. 开发板类型
    config BOARD_TYPE_ESP32S3_Touch_AMOLED_1_8
        bool "Waveshare ESP32-S3-Touch-AMOLED-1.8"
        depends on IDF_TARGET_ESP32S3
  
endchoice




config USE_WECHAT_MESSAGE_STYLE
    bool "Enable WeChat Message Style"
    default n
    help
        使用微信聊天界面风格

config USE_ESP_WAKE_WORD
    bool "Enable Wake Word Detection (without AFE)"
    default n
    depends on IDF_TARGET_ESP32C3 || IDF_TARGET_ESP32C5 || IDF_TARGET_ESP32C6 || (IDF_TARGET_ESP32 && SPIRAM)
    help
        支持 ESP32 C3、ESP32 C5 与 ESP32 C6，增加ESP32支持（需要开启PSRAM）

config USE_AFE_WAKE_WORD
    bool "Enable Wake Word Detection (AFE)"
    default y
    depends on (IDF_TARGET_ESP32S3 || IDF_TARGET_ESP32P4) && SPIRAM
    help
        需要 ESP32 S3 与 PSRAM 支持

config USE_AUDIO_PROCESSOR
    bool "Enable Audio Noise Reduction"
    default y
    depends on (IDF_TARGET_ESP32S3 || IDF_TARGET_ESP32P4) && SPIRAM
    help
        需要 ESP32 S3 与 PSRAM 支持

config USE_DEVICE_AEC
    bool "Enable Device-Side AEC"
    default n
        depends on USE_AUDIO_PROCESSOR && (BOARD_TYPE_ESP_BOX_3 || BOARD_TYPE_ESP_BOX || BOARD_TYPE_ESP_BOX_LITE || BOARD_TYPE_LICHUANG_DEV || BOARD_TYPE_ESP32S3_KORVO2_V3 || BOARD_TYPE_ESP32S3_Touch_AMOLED_1_75 || BOARD_TYPE_ESP32P4_WIFI6_Touch_LCD_4B || BOARD_TYPE_ESP32P4_WIFI6_Touch_LCD_XC)
    help
        因为性能不够，不建议和微信聊天界面风格同时开启

config USE_SERVER_AEC
    bool "Enable Server-Side AEC (Unstable)"
    default n
    depends on USE_AUDIO_PROCESSOR
    help
        启用服务器端 AEC，需要服务器支持

config USE_AUDIO_DEBUGGER
    bool "Enable Audio Debugger"
    default n
    help
        启用音频调试功能，通过UDP发送音频数据

config USE_ACOUSTIC_WIFI_PROVISIONING
    bool "Enable Acoustic WiFi Provisioning"
    default n
    help
        启用声波配网功能，使用音频信号传输 WiFi 配置数据

config AUDIO_DEBUG_UDP_SERVER
    string "Audio Debug UDP Server Address"
    default "192.168.2.100:8000"
    depends on USE_AUDIO_DEBUGGER
    help
        UDP服务器地址，格式: IP:PORT，用于接收音频调试数据

choice IOT_PROTOCOL
    prompt "IoT Protocol"
    default IOT_PROTOCOL_MCP
    help
        IoT 协议，用于获取设备状态与发送控制指令
    config IOT_PROTOCOL_MCP
        bool "MCP 2024-11-05"
    config IOT_PROTOCOL_XIAOZHI
        bool "Xiaozhi IoT 1.0 (Deprecated)"
endchoice

choice I2S_TYPE_TAIJIPI_S3
    depends on BOARD_TYPE_ESP32S3_Taiji_Pi
    prompt "taiji-pi-S3 I2S Type"
    default TAIJIPAI_I2S_TYPE_STD
    help
        I2S 类型选择
    config TAIJIPAI_I2S_TYPE_STD
        bool "I2S Type STD"
    config TAIJIPAI_I2S_TYPE_PDM
        bool "I2S Type PDM"
endchoice

endmenu
```
